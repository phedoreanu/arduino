#include <Bounce2.h>
#include <SPI.h>
//#include <SD.h>
#include <Ethernet.h>

byte mac[] = {
  //generated by me
  0x3A, 0xDB, 0x87, 0x78, 0x37, 0xE5
};
IPAddress ip(192, 168, 0, 177);

const int opto_pin = 2;
const int opto2_pin = 4;
const int switch_pin = 3;
const int led1_pin = 5;
const int led2_pin = 7;
int serial_available = 0;

Bounce debouncer = Bounce();

EthernetServer server(80);

void setup() {
  // put your setup code here, to run once:
  pinMode(opto_pin, OUTPUT);
  pinMode(opto2_pin, OUTPUT);
  pinMode(led1_pin, OUTPUT);
  pinMode(led2_pin, OUTPUT);
  Serial.begin(115200);

  /*Serial.print("Initializing SD card...");
  // disable w5100 SPI while starting SD
  pinMode(10, OUTPUT);
  digitalWrite(10, HIGH);
  if (!SD.begin(4)) {
    Serial.println("initialization failed!");
    return;
  }
  Serial.println("initialization done.");

  if (SD.exists("index.html")) {
    Serial.println("index.html exists.");
  }*/

  // initialize switch
  pinMode(switch_pin, INPUT);
  digitalWrite(switch_pin, HIGH);
  debouncer.attach(switch_pin);
  debouncer.interval(50);

  // web server
  Ethernet.begin(mac);
  server.begin();
  Serial.print("server ready ");
  Serial.print(Ethernet.localIP());
}

void loop() {
  // put your main code here, to run repeatedly:
  if (Serial.available()) {
    const int command = Serial.read();
    if (command == '1') {
      light(opto_pin, HIGH);
    } else if (command == '2') {
      light(opto_pin, LOW);
    } else if (command == '3') {
      light(opto2_pin, HIGH);
    } else if (command == '4') {
      light(opto_pin, LOW);
    }
  }
  if (debouncer.update() && debouncer.read() == LOW) {
    if (digitalRead(opto_pin) == HIGH) {
      light(opto_pin, LOW);
      light(opto2_pin, LOW);
    } else {
      light(opto_pin, HIGH);
      light(opto2_pin, HIGH);
    }
  }
  // listen for incoming clients
  render_requests();
}

void blink_led(const int led_pin, const int miliseconds) {
  digitalWrite(led_pin, HIGH);
  delay(miliseconds);
  digitalWrite(led_pin, LOW);
}

void light(const int pin, const int new_state) {
  digitalWrite(pin, new_state);
  if (new_state == HIGH) {
    blink_led(led1_pin, 100);
    Serial.println("LED on");
  } else {
    blink_led(led2_pin, 100);
    Serial.println("LED off");
  }
}

void render_requests() {
  EthernetClient client = server.available();
  if (client) {
    Serial.println("new client");
    // an http request ends with a blank line
    boolean currentLineIsBlank = true;
    boolean currentLineIsGet = true;
    char methodBuffer[8];
    char requestBuffer[48];
    char pageBuffer[48];
    char paramBuffer[48];
    char protocolBuffer[9];
    int tCount = 0;
    char tBuf[64];
    int r, t;
    char fileName[32];
    char fileType[4];
    while (client.connected()) {
      if (client.available()) {
        char c = client.read();
        Serial.write(c);
        if (currentLineIsGet && tCount < 63) {
          tBuf[tCount] = c;
          tCount++;
          tBuf[tCount] = 0;
        }
        //        Serial.write(c);
        // if you've gotten to the end of the line (received a newline
        // character) and the line is blank, the http request has ended,
        // so you can send a reply
        if (c == '\n' && currentLineIsBlank) {
//          Serial.print(F("POST data: "));
//          Serial.print(tBuf);
          while (client.available()) client.read();
          
          int scanCount = sscanf(tBuf, "%7s %47s %8s", methodBuffer, requestBuffer, protocolBuffer);
          if (scanCount != 3) {
            Serial.println(F("bad request"));
            return;
          }
          //          Serial.print(F("method = "));
          //          Serial.println(methodBuffer);

          char* pch = strtok(requestBuffer, "?");
          if (pch != NULL) {
            strncpy(fileName, pch, 31);
            strncpy(tBuf, pch, 31);

            pch = strtok(NULL, "?");
            if (pch != NULL) {
              strcpy(paramBuffer, pch);
            }
            else paramBuffer[0] = 0;
          }

          strtoupper(requestBuffer);
          strtoupper(tBuf);

          Serial.print(F("file = "));
          Serial.println(requestBuffer);

          pch = strtok(tBuf, ".");
          if (pch != NULL) {
            pch = strtok(NULL, ".");
            if (pch != NULL) strncpy(fileType, pch, 4);
            else fileType[0] = 0;
            Serial.print(F("file type = "));
            Serial.println(fileType);
          }

          //          Serial.print(F("protocol = "));
          //          Serial.println(protocolBuffer);

          Serial.print(F("params = "));
          Serial.println(paramBuffer);

          pch = strtok(paramBuffer, "&");
          Serial.println(pch);
          while (pch != NULL) {
            if (strncmp(pch, "t=", 2) == 0) {
              t = atoi(pch + 2);
              Serial.print("t=");
              Serial.println(t, DEC);
              if (t == 1) {
                light(opto_pin, HIGH);
              } else if (t == 0) {
                light(opto_pin, LOW);
              }
            }
            if (strncmp(pch, "r=", 2) == 0) {
              r = atoi(pch + 2);
              Serial.print("r=");
              Serial.println(r, DEC);
            }
            pch = strtok(NULL, "& ");
          }

          // send a standard http response header
          client.println("HTTP/1.1 200 OK");
          client.println("Content-Type: text/html");
          client.println("Connection: close");  // the connection will be closed after completion of the response
          //          client.println("Refresh: 5");  // refresh the page automatically every 5 sec
          client.println();
          client.println("<!DOCTYPE HTML>");
          client.println("<html>");
          client.println("<head><title>Internet lights!</title><script type=\"text/javascript\">");
          client.println("function show_alert() {alert(\"This is an alert\");}");
          client.println("</script></head>");
          client.println("<form method=\"post\" action=\"/\"><input type=\"hidden\" name=\"t\" value=\"1\"><input type=\"submit\" value=\"Light ON\"></form>");
          client.println("<form method=\"post\" action=\"/\"><input type=\"hidden\" name=\"t\" value=\"0\"><input type=\"submit\" value=\"Light OFF\"></form>");
          client.println("</html>");
          break;
        }
        if (c == '\n') {
          // you're starting a new line
          currentLineIsBlank = true;
        }
        else if (c != '\r') {
          // you've gotten a character on the current line
          currentLineIsBlank = false;
        }
      }
    }
    // give the web browser time to receive the data
    delay(1);
    // close the connection:
    client.stop();
    Serial.println("client disconnected");
  }
}

void  strtoupper(char * aBuf) {
  for (int x = 0; x < strlen(aBuf); x++) {
    aBuf[x] = toupper(aBuf[x]);
  }
}
